## EnvironmentMonitorProject/EnvironmentMonitorPortable/Component/SD_Card/Kconfig.projbuild
```kconfig
menu "SD Card Configuration"

	config MISO_SDCARD
		int "MISO Pin"
		default 21
		help
			Config MISO Pin

	config MOSI_SDCARD
		int "MOSI Pin"
		default 19	
		help
			Config MOSI Pin

	config CLK_SDCARD
		int "CLK Pin"
		default 18
		help
			Config CLK Pin

	config CS_SDCARD
		int "CS Pin"
		default 5
		help
			Config CS Pin

	config SPI_HOST_SDCARD
		int "SPI Host"
		default 2
		help
			Config SPI Host
endmenu
```

## EnvironmentMonitorProject/EnvironmentMonitorPortable/Component/WifiManager/Kconfig.projbuild
```kconfig
menu "Wifi Manager"

    config WIFI_SSID
        string "WiFi SSID"
        default "Unknown"
        help
            SSID (network name) for the example to connect to.

    config WIFI_PASS
        string "WiFi Password"
        default "12345789"
        help
            WiFi password (WPA or WPA2) for the example to use.

    config MAX_RETRY
        int "Maximum retry"
        default 5
        help
            Set the Maximum retry to avoid station reconnecting to the AP unlimited when the AP is really inexistent.

    config AP_SSID
        string "AP_SSID"
        default "Environment Monitor Device"
        help 
            AP SSID

    config AP_PASSWORD
        string "AP_PASSWORD"
        default ""
        help
            AP_PASSWORD
    
    config AP_CHANNEL
        int "AP_CHANNEL"
        default 1
        help
            AP_CHANNEL


endmenu
```

## EnvironmentMonitorProject/EnvironmentMonitorPortable/main/Kconfig.projbuild
```kconfig
menu "Project Configuration"

    config WS_URL
        string "URL WebSocket"
        default "ws://localhost:8080" 
        help 
            Set the URL of WS Servers
    
    config HOST_IP_ADDR 
        string "IP Host"
        default "192.168.1.100"
        help
            Config ip host

    config HTTP_PORT
        int "Port HTTP"
        default 5500
        help
            Config port http
endmenu
```
